## boards/shields/kiwiboard/Kconfig.defconfig
```kconfig
# SPDX-License-Identifier: MIT

if SHIELD_KIWIBOARD_LEFT || SHIELD_KIWIBOARD_RIGHT

config ZMK_KEYBOARD_NAME
	default "Kiwiboard"

config ZMK_SPLIT
	default y

endif
```

## boards/shields/kiwiboard/Kconfig.shield
```kconfig
# SPDX-License-Identifier: MIT

config SHIELD_KIWIBOARD_LEFT
	def_bool $(shields_list_contains,kiwiboard_left)

config SHIELD_KIWIBOARD_RIGHT
	def_bool $(shields_list_contains,kiwiboard_right)
```

## boards/shields/kiwiboard_dongle/Kconfig.defconfig
```kconfig
# SPDX-License-Identifier: MIT

if SHIELD_KIWIBOARD_DONGLE

config ZMK_KEYBOARD_NAME
	default "Kiwiboard"

config ZMK_SPLIT_ROLE_CENTRAL
	default y

config ZMK_SPLIT
	default y

config ZMK_SPLIT_BLE_CENTRAL_PERIPHERALS
	default 2

config BT_MAX_CONN
	default 7

config BT_MAX_PAIRED
	default 7

config ZMK_SPLIT_BATTERY_HID_REPORT
	bool "Expose left/right peripheral battery levels via a custom USB HID report"
	default y
	depends on ZMK_USB && ZMK_SPLIT_BLE_CENTRAL_BATTERY_LEVEL_FETCHING

endif
```

## boards/shields/kiwiboard_dongle/Kconfig.shield
```kconfig
# SPDX-License-Identifier: MIT

config SHIELD_KIWIBOARD_DONGLE
	def_bool $(shields_list_contains,kiwiboard_dongle)
```

## config/west.yml
```yaml
manifest:
  defaults:
    revision: v0.3
  remotes:
    - name: zmkfirmware
      url-base: https://github.com/zmkfirmware
    - name: bluedrink9
      url-base: https://github.com/BlueDrink9
    - name: englmaxi
      url-base: https://github.com/englmaxi
  projects:
    - name: zmk
      remote: zmkfirmware
      import: app/west.yml
    - name: zmk-poor-mans-led-indicator
      remote: bluedrink9
      revision: main
    - name: zmk-dongle-display
      remote: englmaxi
      revision: v0.3
  self:
    path: config
```
