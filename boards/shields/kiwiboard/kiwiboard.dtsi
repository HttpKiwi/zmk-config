/*
 * Kiwiboard half — shared kscan (handwire pins).
 * Physical layout lives in config/kiwiboard.dtsi.
 */

#include <dt-bindings/zmk/matrix_transform.h>

/ {
	chosen {
		zmk,kscan = &kscan0;
	};

	kscan0: kscan0 {
		compatible = "zmk,kscan-gpio-matrix";
		wakeup-source;
		diode-direction = "col2row";

		/* rows top → thumbs */
		row-gpios
			= <&pro_micro 5 (GPIO_ACTIVE_HIGH | GPIO_PULL_DOWN)>  /* P0.24 */
			, <&pro_micro 6 (GPIO_ACTIVE_HIGH | GPIO_PULL_DOWN)>  /* P1.00 */
			, <&pro_micro 7 (GPIO_ACTIVE_HIGH | GPIO_PULL_DOWN)>  /* P0.11 */
			, <&pro_micro 8 (GPIO_ACTIVE_HIGH | GPIO_PULL_DOWN)>  /* P1.04 */
			;
	};
};
